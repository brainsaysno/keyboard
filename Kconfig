## Kconfig
```kconfig
config ZMK_BEHAVIOR_SHIFT_SCROLL
    bool
    default y
    depends on DT_HAS_ZMK_BEHAVIOR_SHIFT_SCROLL_ENABLED
    depends on ZMK_POINTING
    depends on !ZMK_SPLIT || ZMK_SPLIT_ROLE_CENTRAL

config ZMK_DASHBOARD_RELAY
    bool "Relay the Mac dashboard app's frames to the split peripheral's display"
    default y
    depends on ZMK_SPLIT_BLE && ZMK_SPLIT_ROLE_CENTRAL

config ZMK_DASHBOARD_DISPLAY
    bool "Show the Mac dashboard app's frames on this split peripheral's display"
    depends on ZMK_SPLIT_BLE && !ZMK_SPLIT_ROLE_CENTRAL
    depends on ZMK_DISPLAY_STATUS_SCREEN_CUSTOM
    select LV_USE_CANVAS
    select CRC
```

## boards/shields/nice_view_dashboard/Kconfig.shield
```kconfig
config SHIELD_NICE_VIEW_DASHBOARD
    def_bool $(shields_list_contains,nice_view_dashboard)
```

## dts/bindings/behaviors/zmk,behavior-mac-text.yaml
```yaml
description: Receives text slots relayed from the Mac companion app and shows them on the display

compatible: "zmk,behavior-mac-text"

include: zero_param.yaml
```

## dts/bindings/behaviors/zmk,behavior-shift-scroll.yaml
```yaml
description: Mouse movement, or scrolling while either Shift key is held

compatible: "zmk,behavior-shift-scroll"

include: zero_param.yaml

properties:
  bindings:
    type: phandle-array
    required: true
    description: Mouse movement followed by mouse scrolling; both take one parameter
```
